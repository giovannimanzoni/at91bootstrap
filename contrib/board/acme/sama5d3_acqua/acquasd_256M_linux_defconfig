## contrib/board/acme/sama5d3_acqua/acquasd_256M_linux_defconfig
```kconfig
CONFIG_SAMA5D3_ACQUA=y
CONFIG_CPU_CLK_498MHZ=y # avoid wait state with very low degraded performance
CONFIG_BUS_SPEED_166MHZ=y
CONFIG_DEBUG=y
CONFIG_SCLK=y
CONFIG_PM_EXTERNAL_DEVICES=y
CONFIG_MAC1_PHY=y
CONFIG_RAM_256MB=y
CONFIG_SDCARD=y
CONFIG_LOAD_LINUX=y
CONFIG_IMAGE_NAME="zImage"
```
